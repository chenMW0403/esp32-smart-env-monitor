## sdkconfig.defaults
```kconfig
# Target: ESP32-S3
CONFIG_IDF_TARGET="esp32s3"

# FreeRTOS
CONFIG_FREERTOS_HZ=1000
CONFIG_FREERTOS_USE_TRACE_FACILITY=y
CONFIG_FREERTOS_GENERATE_RUN_TIME_STATS=y

# Dual core
CONFIG_ESP_MAIN_TASK_STACK_SIZE=8192

# Wi-Fi
CONFIG_ESP_WIFI_STATIC_RX_BUFFER_NUM=10
CONFIG_ESP_WIFI_DYNAMIC_RX_BUFFER_NUM=32
CONFIG_ESP_WIFI_DYNAMIC_TX_BUFFER_NUM=32

# MQTT
CONFIG_MQTT_PROTOCOL_311=y

# LWIP
CONFIG_LWIP_MAX_SOCKETS=10

# Power Management
CONFIG_PM_ENABLE=y
CONFIG_PM_PROFILING=y

# Partition table
CONFIG_PARTITION_TABLE_CUSTOM=y
CONFIG_PARTITION_TABLE_CUSTOM_FILENAME="partitions.csv"

# Log level
CONFIG_LOG_DEFAULT_LEVEL_INFO=y

# I2C
CONFIG_I2C_ENABLE_DEBUG_LOG=n

# SPIRAM (optional, S3 supports it)
CONFIG_SPIRAM=n

# Stack canary
CONFIG_ESP_TASK_WDT_CHECK_IDLE_TASK_CPU0=n
CONFIG_ESP_TASK_WDT_CHECK_IDLE_TASK_CPU1=n
```
