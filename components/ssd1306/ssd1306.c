/**
 * @file ssd1306.c
 * @brief SSD1306 OLED Driver Implementation
 */

#include "ssd1306.h"
#include "esp_log.h"
#include <string.h>

static const char *TAG = "SSD1306";

/* SSD1306 commands */
#define SSD1306_CMD_DISPLAY_OFF     0xAE
#define SSD1306_CMD_DISPLAY_ON      0xAF
#define SSD1306_CMD_SET_CONTRAST    0x81
#define SSD1306_CMD_NORMAL_DISPLAY  0xA6
#define SSD1306_CMD_SET_MUX_RATIO   0xA8
#define SSD1306_CMD_SET_DISPLAY_OFFSET   0xD3
#define SSD1306_CMD_SET_START_LINE  0x40
#define SSD1306_CMD_SET_SEGMENT_REMAP    0xA1
#define SSD1306_CMD_SET_COM_SCAN_DIR     0xC8
#define SSD1306_CMD_SET_COM_PINS    0xDA
#define SSD1306_CMD_SET_CLOCK_DIV   0xD5
#define SSD1306_CMD_SET_PRECHARGE   0xD9
#define SSD1306_CMD_SET_VCOMH       0xDB
#define SSD1306_CMD_CHARGE_PUMP     0x8D

/* 6x8 ASCII font (0x20-0x7F) */
static const uint8_t font_6x8[][6] = {
    {0x00,0x00,0x00,0x00,0x00,0x00}, /* space */
    {0x00,0x00,0x5F,0x00,0x00,0x00}, /* ! */
    {0x00,0x07,0x00,0x07,0x00,0x00}, /* " */
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    {0x10,0x08,0x08,0x10,0x08,0x00}, /* ~ */
};

static esp_err_t ssd1306_send_cmd(ssd1306_handle_t *handle, uint8_t cmd)
{
    uint8_t buf[2] = {0x00, cmd};  /* Co=0, D/C#=0 => command */
    return i2c_master_transmit(handle->dev, buf, 2, 100);
}

esp_err_t ssd1306_init(ssd1306_handle_t *handle,
                       i2c_master_bus_handle_t bus,
                       uint16_t addr)
{
    i2c_device_config_t dev_cfg = {
        .dev_addr_length = I2C_ADDR_BIT_LEN_7,
        .device_address  = addr,
        .scl_speed_hz    = 400000,  /* 400 kHz for display */
    };
    esp_err_t ret = i2c_master_bus_add_device(bus, &dev_cfg, &handle->dev);
    if (ret != ESP_OK) {
        ESP_LOGE(TAG, "Add device failed: %s", esp_err_to_name(ret));
        return ret;
    }

    /* Init sequence from SSD1306 datasheet */
    const uint8_t init_cmds[] = {
        SSD1306_CMD_DISPLAY_OFF,
        SSD1306_CMD_SET_CLOCK_DIV,  0x80,
        SSD1306_CMD_SET_MUX_RATIO,  0x3F,       /* 64-1 */
        SSD1306_CMD_SET_DISPLAY_OFFSET, 0x00,
        SSD1306_CMD_SET_START_LINE | 0x00,
        SSD1306_CMD_CHARGE_PUMP,    0x14,       /* Enable charge pump */
        SSD1306_CMD_SET_SEGMENT_REMAP | 0x01,   /* Column 127 = SEG0 */
        SSD1306_CMD_SET_COM_SCAN_DIR | 0x08,    /* Remapped mode */
        SSD1306_CMD_SET_COM_PINS,   0x12,
        SSD1306_CMD_SET_CONTRAST,   0xCF,
        SSD1306_CMD_SET_PRECHARGE,  0xF1,
        SSD1306_CMD_SET_VCOMH,      0x40,
        SSD1306_CMD_NORMAL_DISPLAY,
        0x20, 0x02,                              /* Horizontal addressing mode */
        SSD1306_CMD_DISPLAY_ON,
    };

    for (int i = 0; i < sizeof(init_cmds); i++) {
        ret = ssd1306_send_cmd(handle, init_cmds[i]);
        if (ret != ESP_OK) {
            ESP_LOGE(TAG, "Init cmd 0x%02X failed: %s", init_cmds[i], esp_err_to_name(ret));
            return ret;
        }
    }

    ssd1306_clear(handle);
    ssd1306_update(handle);

    ESP_LOGI(TAG, "SSD1306 128x64 initialized at 0x%02X", addr);
    return ESP_OK;
}

void ssd1306_clear(ssd1306_handle_t *handle)
{
    memset(handle->buffer, 0, sizeof(handle->buffer));
}

void ssd1306_draw_char(ssd1306_handle_t *handle, uint8_t x, uint8_t page, char c)
{
    if (page >= SSD1306_PAGES || x >= SSD1306_WIDTH) return;
    if (c < 0x20 || c > 0x7E) c = '?';

    const uint8_t *glyph = font_6x8[c - 0x20];
    uint16_t offset = (uint16_t)page * SSD1306_WIDTH + x;

    for (int i = 0; i < 6 && (x + i) < SSD1306_WIDTH; i++) {
        handle->buffer[offset + i] = glyph[i];
    }
}

void ssd1306_draw_string(ssd1306_handle_t *handle, uint8_t x, uint8_t page, const char *str)
{
    while (*str && x < SSD1306_WIDTH) {
        ssd1306_draw_char(handle, x, page, *str);
        x += 6;
        str++;
    }
}

esp_err_t ssd1306_update(ssd1306_handle_t *handle)
{
    /* Set column address range and page address range */
    uint8_t cmds[] = {
        0x21, 0x00, 0x7F,   /* Column: 0 - 127 */
        0x22, 0x00, 0x07,   /* Page: 0 - 7 */
    };
    for (int i = 0; i < sizeof(cmds); i++) {
        ssd1306_send_cmd(handle, cmds[i]);
    }

    /* Send buffer in chunks (I2C has max transaction size) */
    /* Each chunk: 1 byte control + up to 16 bytes data */
    #define CHUNK_SIZE 16
    uint8_t chunk[CHUNK_SIZE + 1];
    chunk[0] = 0x40;  /* Co=0, D/C#=1 => data */

    uint16_t total = sizeof(handle->buffer);
    uint16_t offset = 0;

    while (offset < total) {
        uint16_t len = total - offset;
        if (len > CHUNK_SIZE) len = CHUNK_SIZE;

        memcpy(&chunk[1], &handle->buffer[offset], len);
        esp_err_t ret = i2c_master_transmit(handle->dev, chunk, len + 1, 200);
        if (ret != ESP_OK) {
            ESP_LOGE(TAG, "Update failed at offset %d: %s", offset, esp_err_to_name(ret));
            return ret;
        }
        offset += len;
    }

    return ESP_OK;
}
